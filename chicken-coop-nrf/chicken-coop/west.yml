## chicken-coop-nrf/chicken-coop/west.yml
```yaml
manifest:
  remotes:
    - name: ncs
      url-base: https://github.com/nrfconnect
  projects:
    - name: sdk-nrf
      remote: ncs
      path: nrf
      revision: v2.5.0
      import: true
      clone-depth: 1
  self:
    path: chicken_coop
```
